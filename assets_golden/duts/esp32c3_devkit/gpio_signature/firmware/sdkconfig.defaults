## assets_golden/duts/esp32c3_devkit/gpio_signature/firmware/sdkconfig.defaults
```kconfig
# Keep the project target stable even from a clean checkout.
CONFIG_ESPTOOLPY_FLASHSIZE_4MB=y
# CONFIG_ESPTOOLPY_FLASHSIZE_2MB is not set
CONFIG_ESPTOOLPY_FLASHSIZE="4MB"
```

## assets_golden/duts/esp32s3_devkit/gpio_signature/firmware/sdkconfig.defaults
```kconfig
# Route console output to native USB Serial/JTAG on CON1.
CONFIG_ESP_CONSOLE_USB_SERIAL_JTAG=y
# CONFIG_ESP_CONSOLE_UART_DEFAULT is not set
CONFIG_ESPTOOLPY_MONITOR_BAUD=115200
```

## firmware/targets/esp32_wroom32d/hello/sdkconfig.defaults
```kconfig
# Stage 0 — minimal console validation. No WiFi, no BLE, no custom partitions.
CONFIG_ESP_CONSOLE_UART_DEFAULT=y
CONFIG_ESP_MAIN_TASK_STACK_SIZE=4096
```

## firmware/targets/esp32_wroom32d_suite/sdkconfig.defaults
```kconfig
CONFIG_ESP_CONSOLE_UART_DEFAULT=y
CONFIG_BT_ENABLED=y
CONFIG_BT_NIMBLE_ENABLED=y
CONFIG_ESP_WIFI_ENABLED=y
CONFIG_PARTITION_TABLE_CUSTOM=y
CONFIG_PARTITION_TABLE_CUSTOM_FILENAME="partitions.csv"
CONFIG_PARTITION_TABLE_OFFSET=0x8000
CONFIG_ESP_MAIN_TASK_STACK_SIZE=8192
# IRAM budget: ESP32 classic has 128KB IRAM. Disable WiFi IRAM opt to fit.
CONFIG_ESP_WIFI_IRAM_OPT=n
CONFIG_ESP_WIFI_RX_IRAM_OPT=n
```

## firmware/targets/esp32c3_devkit/common/sdkconfig.defaults
```kconfig
CONFIG_ESP_CONSOLE_USB_SERIAL_JTAG=y
CONFIG_BT_ENABLED=y
CONFIG_BT_NIMBLE_ENABLED=y
CONFIG_ESP_WIFI_ENABLED=y
CONFIG_PARTITION_TABLE_CUSTOM=y
CONFIG_PARTITION_TABLE_CUSTOM_FILENAME="../common/partitions.csv"
CONFIG_PARTITION_TABLE_OFFSET=0x8000
CONFIG_ESP_MAIN_TASK_STACK_SIZE=8192
CONFIG_ESP_WIFI_IRAM_OPT=n
CONFIG_ESP_WIFI_RX_IRAM_OPT=n
CONFIG_ESPTOOLPY_AFTER_RESET=y
```

## firmware/targets/esp32c3_suite/sdkconfig.defaults
```kconfig
CONFIG_ESP_CONSOLE_USB_SERIAL_JTAG=y
CONFIG_BT_ENABLED=y
CONFIG_BT_NIMBLE_ENABLED=y
CONFIG_ESP_WIFI_ENABLED=y
CONFIG_PARTITION_TABLE_CUSTOM=y
CONFIG_PARTITION_TABLE_CUSTOM_FILENAME="partitions.csv"
CONFIG_PARTITION_TABLE_OFFSET=0x8000
CONFIG_ESP_MAIN_TASK_STACK_SIZE=8192
```

## firmware/targets/esp32c5_ble_adv/sdkconfig.defaults
```kconfig
CONFIG_ESP_CONSOLE_UART_DEFAULT=y
CONFIG_ESP_DEFAULT_CPU_FREQ_MHZ_160=y
CONFIG_BT_ENABLED=y
CONFIG_BT_NIMBLE_ENABLED=y
```

## firmware/targets/esp32c5_devkit/test_i2c/sdkconfig.defaults
```kconfig
CONFIG_ESP_CONSOLE_UART_DEFAULT=y
CONFIG_ESP_DEFAULT_CPU_FREQ_MHZ_160=y
CONFIG_BT_ENABLED=y
CONFIG_BT_NIMBLE_ENABLED=y
CONFIG_ESP_WIFI_ENABLED=y
CONFIG_PARTITION_TABLE_CUSTOM=y
CONFIG_PARTITION_TABLE_CUSTOM_FILENAME="partitions.csv"
CONFIG_PARTITION_TABLE_OFFSET=0x8000
CONFIG_ESP_MAIN_TASK_STACK_SIZE=8192
CONFIG_I2C_ENABLE_SLAVE_DRIVER_VERSION_2=y
CONFIG_ESP_CONSOLE_SECONDARY_NONE=y
CONFIG_USJ_ENABLE_USB_SERIAL_JTAG=n
```

## firmware/targets/esp32c5_dual_uart_probe/sdkconfig.defaults
```kconfig
# Console: NONE — firmware drives UART0 and USB Serial/JTAG explicitly.
# Each port sends role-specific messages; no cross-mirroring.
CONFIG_ESP_CONSOLE_NONE=y
CONFIG_ESP_DEFAULT_CPU_FREQ_MHZ_160=y
```

## firmware/targets/esp32c5_suite_ext/sdkconfig.defaults
```kconfig
# Console on UART0 (GPIO11 TX / GPIO12 RX via CH341 bridge)
CONFIG_ESP_CONSOLE_UART_DEFAULT=y
CONFIG_ESP_DEFAULT_CPU_FREQ_MHZ_160=y

# Bluetooth (NimBLE stack)
CONFIG_BT_ENABLED=y
CONFIG_BT_NIMBLE_ENABLED=y

# Wi-Fi (dual-band on ESP32-C5)
CONFIG_ESP_WIFI_ENABLED=y

# Custom partition table — larger app partition for BLE+WiFi binary
CONFIG_PARTITION_TABLE_CUSTOM=y
CONFIG_PARTITION_TABLE_CUSTOM_FILENAME="partitions.csv"
CONFIG_PARTITION_TABLE_OFFSET=0x8000
```

## firmware/targets/esp32c6_devkit/common/sdkconfig.defaults
```kconfig
CONFIG_ESP_CONSOLE_UART_DEFAULT=y
CONFIG_BT_ENABLED=y
CONFIG_BT_NIMBLE_ENABLED=y
CONFIG_ESP_WIFI_ENABLED=y
CONFIG_PARTITION_TABLE_CUSTOM=y
CONFIG_PARTITION_TABLE_CUSTOM_FILENAME="../common/partitions.csv"
CONFIG_PARTITION_TABLE_OFFSET=0x8000
CONFIG_ESP_MAIN_TASK_STACK_SIZE=8192
CONFIG_ESP_WIFI_IRAM_OPT=n
CONFIG_ESP_WIFI_RX_IRAM_OPT=n
CONFIG_I2C_ENABLE_SLAVE_DRIVER_VERSION_2=y
```

## firmware/targets/esp32c6_suite_ext/sdkconfig.defaults
```kconfig
# Enable Bluetooth (NimBLE stack)
CONFIG_BT_ENABLED=y
CONFIG_BT_NIMBLE_ENABLED=y

# Wi-Fi (explicit; enabled by default on ESP32-C6)
CONFIG_ESP_WIFI_ENABLED=y

# Custom partition table — larger app partition for BLE+WiFi binary
CONFIG_PARTITION_TABLE_CUSTOM=y
CONFIG_PARTITION_TABLE_CUSTOM_FILENAME="partitions.csv"
CONFIG_PARTITION_TABLE_OFFSET=0x8000
```
